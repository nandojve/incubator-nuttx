## arch/bootloader/Kconfig
```kconfig
#
# For a description of the syntax of this configuration file,
# see the file kconfig-language.txt in the NuttX tools repository.
#

comment "Bootloader"

choice ARCH_BOOTLOADER_TYPE
	prompt "Select bootloader"
	default BOOTLOADER_DISABLED
	---help---
		Select the bootloader type.

config BOOTLOADER_DISABLED
	bool "Disabled"
	---help---
		Build applications without bootloader support.

config BOOTLOADER_MCUBOOT
	bool "MCUboot"
	depends on ARCH_HAVE_BOOTLOADER_MCUBOOT
	---help---
		Enable board support to run MCUboot bootloader and
		applications.

endchoice

if !BOOTLOADER_DISABLED

menu "Configurations"

if BOOTLOADER_MCUBOOT
source "arch/bootloader/mcuboot/Kconfig"
endif

endmenu

endif
```

## arch/bootloader/mcuboot/Kconfig
```kconfig
#
# For a description of the syntax of this configuration file,
# see the file kconfig-language.txt in the NuttX tools repository.
#

config BOOTLOADER_MCUBOOT_OPTIONS
	bool
	default y
	select BCH
	select BOARDCTL_RESET
	select MTD
	select MTD_BYTE_WRITE
	select MTD_PARTITION
	select RAW_BINARY

config BOOTLOADER_MCUBOOT_HEADER_SIZE
	hex
	default 0x200

config BOOTLOADER_MCUBOOT_ERASEDVALUE
	hex
	default 0xff

choice BOOTLOADER_MCUBOOT_MEDIA
	prompt "Select bootloader media type"
	default BOOTLOADER_MCUBOOT_MEDIA_NONE
	---help---
		Select bootloader media type.

config BOOTLOADER_MCUBOOT_MEDIA_NONE
	bool "Not defined"
	---help---
		The storage memory should be defined.

config BOOTLOADER_MCUBOOT_MEDIA_PROGMEM
	bool "Progmem"
	select MTD_PROGMEM
	select MTD_PROGMEM_ERASESTATE
	depends on ARCH_HAVE_PROGMEM
	---help---
		Use progmem internal memory for store bootloader and
		applications.
endchoice

config BOOTLOADER_MCUBOOT_BUILD_BOOTLOADER
	bool "Build the fist stage bootloader itself"
	default n
	select BOARDCTL
	select BOARDCTL_BOOT_IMAGE
	---help---
		Build the MCUboot first stage bootloader application. This
		application is the first application that will run after reset.
		To build normal applications that MCUboot should test and run,
		left this option untouched.

config BOOTLOADER_MCUBOOT_SLOT_SIZE
	hex "MCUboot application image slot size (in bytes)"

config BOOTLOADER_MCUBOOT_SCRATCH_SIZE
	hex "MCUboot scratch partition size (in bytes)"

config BOOTLOADER_MCUBOOT_PRIMARY_SLOT_OFFSET
	hex "MCUboot application image primary slot offset"

config BOOTLOADER_MCUBOOT_SECONDARY_SLOT_OFFSET
	hex "MCUboot application image secondary slot offset"

config BOOTLOADER_MCUBOOT_SCRATCH_OFFSET
	hex "MCUboot scratch partition offset"

config BOOTLOADER_MCUBOOT_BOOT_DEVPATH
	string "Bootloader device path"
	default "/dev/boot/bootloader"

config BOOTLOADER_MCUBOOT_PRIMARY_SLOT_DEVPATH
	string "Application image primary slot device path"
	default "/dev/boot/slot-0"

config BOOTLOADER_MCUBOOT_SECONDARY_SLOT_DEVPATH
	string "Application image secondary slot device path"
	default "/dev/boot/slot-1"

config BOOTLOADER_MCUBOOT_SCRATCH_DEVPATH
	string "Scratch partition device path"
	default "/dev/boot/scratch"
```

## boards/arm/samv7/common/Kconfig
```kconfig
#
# For a description of the syntax of this configuration file,
# see the file kconfiglanguage.txt in the NuttX tools repository.
#

if BOOTLOADER_MCUBOOT

config BOOTLOADER_MCUBOOT_OPTIONS
	select ARCH_RAMFUNCS
	select SAMV7_SYSTEMRESET

config BOOTLOADER_MCUBOOT_MEDIA_PROGMEM
	imply SAMV7_PROGMEM
	imply SAMV7_PROGMEM_ERASESTATE

config BOOTLOADER_MCUBOOT_SLOT_SIZE
	default 0x28000  if SAMV7_MEM_FLASH_512
	default 0x60000  if SAMV7_MEM_FLASH_1024
	default 0xe0000  if SAMV7_MEM_FLASH_2048

config BOOTLOADER_MCUBOOT_PRIMARY_SLOT_OFFSET
	default 0x20000

config BOOTLOADER_MCUBOOT_SECONDARY_SLOT_OFFSET
	default 0x48000  if SAMV7_MEM_FLASH_512
	default 0x80000  if SAMV7_MEM_FLASH_1024
	default 0x100000 if SAMV7_MEM_FLASH_2048

config BOOTLOADER_MCUBOOT_SCRATCH_SIZE
	default 0x10000  if SAMV7_MEM_FLASH_512
	default 0x20000

config BOOTLOADER_MCUBOOT_SCRATCH_OFFSET
	default 0x70000  if SAMV7_MEM_FLASH_512
	default 0xe0000  if SAMV7_MEM_FLASH_1024
	default 0x1e0000 if SAMV7_MEM_FLASH_2048

endif # BOOTLOADER_MCUBOOT

config BOARD_SAMV7_COMMON
       bool "Board common logic"
       default y
       ---help---
               Board common logic located in each board/common folder.

if BOARD_SAMV7_COMMON

comment "Intentionally Empty"

endif # BOARD_SAMV7_COMMON
```
